## share/tuya/TuyaOS/vendor/ak3760e/tuyaos/components/base_hal/Config.in
```kconfig
menu "Tuya Base HAL"

menu "Module"
comment "All modules of Base HAL are compiled by default"
endmenu

menu "Test"
config TUYA_BASE_HAL_TEST
    bool "Base HAL Test"
    default n

source "sdk/base_hal/test/*/Config.in"
endmenu

endmenu
```

## share/tuya/TuyaOS/vendor/ak3760e/tuyaos/components/base_hal/test/adc/Config.in
```kconfig
config TUYA_HAL_TEST_ADC
	bool "adc test"
	default n
	depends on TUYA_BASE_HAL_TEST
```

## share/tuya/TuyaOS/vendor/ak3760e/tuyaos/components/base_hal/test/backlight/Config.in
```kconfig
config TUYA_HAL_TEST_BACKLIGHT
	bool "backlight test"
	default n
	depends on TUYA_BASE_HAL_TEST
```

## share/tuya/TuyaOS/vendor/ak3760e/tuyaos/components/base_hal/test/cmd/Config.in
```kconfig
config TUYA_HAL_TEST_CMD
	bool "cmd test"
	default n
	depends on TUYA_BASE_HAL_TEST
```

## share/tuya/TuyaOS/vendor/ak3760e/tuyaos/components/base_hal/test/gpio/Config.in
```kconfig
config TUYA_HAL_TEST_GPIO
	bool "gpio test"
	default n
	depends on TUYA_BASE_HAL_TEST
```

## share/tuya/TuyaOS/vendor/ak3760e/tuyaos/components/base_hal/test/gpio_key/Config.in
```kconfig
config TUYA_HAL_TEST_GPIO_KEY
	bool "gpio key test"
	default n
	depends on TUYA_BASE_HAL_TEST
```

## share/tuya/TuyaOS/vendor/ak3760e/tuyaos/components/base_hal/test/hw_event/Config.in
```kconfig
config TUYA_HAL_TEST_HW_EVENT
	bool "hw event test"
	default n
	depends on TUYA_BASE_HAL_TEST
```

## share/tuya/TuyaOS/vendor/ak3760e/tuyaos/components/base_hal/test/input_event/Config.in
```kconfig
config TUYA_HAL_TEST_INPUT_EVENT
	bool "input event test"
	default n
	depends on TUYA_BASE_HAL_TEST
```

## share/tuya/TuyaOS/vendor/ak3760e/tuyaos/components/base_hal/test/ir_recv/Config.in
```kconfig
config TUYA_HAL_TEST_IR_RECV
	bool "ir recv test"
	default n
	depends on TUYA_BASE_HAL_TEST
```

## share/tuya/TuyaOS/vendor/ak3760e/tuyaos/components/base_hal/test/ir_send/Config.in
```kconfig
config TUYA_HAL_TEST_IR_SEND
	bool "ir send test"
	default n
	depends on TUYA_BASE_HAL_TEST
```

## share/tuya/TuyaOS/vendor/ak3760e/tuyaos/components/base_hal/test/ircut/Config.in
```kconfig
config TUYA_HAL_TEST_IRCUT
	bool "ircut test"
	default n
	depends on TUYA_BASE_HAL_TEST
```

## share/tuya/TuyaOS/vendor/ak3760e/tuyaos/components/base_hal/test/led/Config.in
```kconfig
config TUYA_HAL_TEST_LED
	bool "led test"
	default n
	depends on TUYA_BASE_HAL_TEST
```

## share/tuya/TuyaOS/vendor/ak3760e/tuyaos/components/base_hal/test/led_pwm/Config.in
```kconfig
config TUYA_HAL_TEST_LED_PWM
	bool "led-pwm test"
	default n
	depends on TUYA_BASE_HAL_TEST
```

## share/tuya/TuyaOS/vendor/ak3760e/tuyaos/components/base_hal/test/modem_4g/Config.in
```kconfig
config TUYA_HAL_TEST_MODEM_4G
	bool "modem 4g test"
	default n
	depends on TUYA_BASE_HAL_TEST
```

## share/tuya/TuyaOS/vendor/ak3760e/tuyaos/components/base_hal/test/motor/Config.in
```kconfig
config TUYA_HAL_TEST_MOTOR
	bool "motor test"
	default n
	depends on TUYA_BASE_HAL_TEST
```

## share/tuya/TuyaOS/vendor/ak3760e/tuyaos/components/base_hal/test/network/Config.in
```kconfig
config TUYA_HAL_TEST_NETWORK
	bool "network test"
	default n
	depends on TUYA_BASE_HAL_TEST
```

## share/tuya/TuyaOS/vendor/ak3760e/tuyaos/components/base_hal/test/pir/Config.in
```kconfig
config TUYA_HAL_TEST_PIR
	bool "pir test"
	default n
	depends on TUYA_BASE_HAL_TEST
```

## share/tuya/TuyaOS/vendor/ak3760e/tuyaos/components/base_hal/test/power/Config.in
```kconfig
config TUYA_HAL_TEST_POWER
	bool "power test"
	default n
	depends on TUYA_BASE_HAL_TEST
```

## share/tuya/TuyaOS/vendor/ak3760e/tuyaos/components/base_hal/test/pwm/Config.in
```kconfig
config TUYA_HAL_TEST_PWM
	bool "pwm test"
	default n
	depends on TUYA_BASE_HAL_TEST
```

## share/tuya/TuyaOS/vendor/ak3760e/tuyaos/components/base_hal/test/tar/Config.in
```kconfig
config TUYA_HAL_TEST_TAR
	bool "tar test"
	default n
	depends on TUYA_BASE_HAL_TEST
```

## share/tuya/TuyaOS/vendor/ak3760e/tuyaos/components/base_hal/test/video/Config.in
```kconfig
config TUYA_HAL_TEST_VIDEO
	bool "video test"
	default n
	depends on TUYA_BASE_HAL_TEST

config TUYA_HAL_TEST_VIDEO_SSC33X
	bool "ssc33x video test"
	default n
	depends on TUYA_HAL_TEST_VIDEO
```

## share/tuya/TuyaOS/vendor/ak3760e/tuyaos/components/base_hal/test/watchdog/Config.in
```kconfig
config TUYA_HAL_TEST_WATCHDOG
	bool "watchdog test"
	default n
	depends on TUYA_BASE_HAL_TEST
```
